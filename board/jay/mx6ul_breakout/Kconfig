## board/jay/mx6ul_breakout/Kconfig
```kconfig
if TARGET_MX6UL_BREAKOUT

config SYS_BOARD
	default "mx6ul_breakout"

config SYS_VENDOR
	default "jay"

config SYS_CONFIG_NAME
	default "mx6ul_breakout"

endif
```
